## esp32/components/muse/Kconfig.gadget
```kconfig
# Copyright (c) Meta Platforms, Inc. and affiliates.
#
# Licensed under the Apache License, Version 2.0 (the "License");
# you may not use this file except in compliance with the License.
# You may obtain a copy of the License at
#
#     http://www.apache.org/licenses/LICENSE-2.0
#
# Unless required by applicable law or agreed to in writing, software
# distributed under the License is distributed on an "AS IS" BASIS,
# WITHOUT WARRANTIES OR CONDITIONS OF ANY KIND, either express or implied.
# See the License for the specific language governing permissions and
# limitations under the License.

# Sourced from Kconfig: the Waveshare ESP32-S3-Touch-AMOLED-2.16's other
# peripherals (muse_extras.c).

menu "Waveshare 2.16 extras: microSD, clock, motion"
    depends on MUSE_BOARD_WAVESHARE_S3_216

    config MUSE_GADGET_EXTRAS
        bool "Use the board's microSD slot, RTC and IMU"
        default y
        help
            The 2.16's PCF85063 real-time clock, QMI8658 IMU and microSD
            slot, and a clock and battery on the face. One
            low-priority task polls them (muse_extras.c).

    config MUSE_GADGET_TZ
        string "Time zone (POSIX TZ string)"
        depends on MUSE_GADGET_EXTRAS
        default "PST8PDT,M3.2.0,M11.1.0"
        help
            Local time for the clock, the alarm and file names. The RTC
            keeps UTC.

    config MUSE_GADGET_SD
        bool "microSD card: save images and log captions"
        depends on MUSE_GADGET_EXTRAS
        default y
        help
            Mounts a FAT card at /sdcard (SDMMC, 1-bit) if one is in the
            slot. Without a card everything else carries on.

    config MUSE_GADGET_SD_SAVE_IMAGES
        bool "Save display.draw_url images to /sdcard/muse/images by default"
        depends on MUSE_GADGET_SD
        default y
        help
            The default for the "sd_save_images" key in the "gadget" NVS
            namespace, which overrides it once set.

    config MUSE_GADGET_CAPTION_LOG
        bool "Append what was heard and Muse's replies to /sdcard/muse/captions.log"
        depends on MUSE_GADGET_SD
        default y

    config MUSE_GADGET_RTC
        bool "PCF85063 clock, set from NTP"
        depends on MUSE_GADGET_EXTRAS
        default y
        help
            Restores the time from the RTC at boot, sets it over SNTP once
            Wi-Fi is up and writes the result back to the RTC.

    config MUSE_GADGET_NTP_SERVER
        string "NTP server"
        depends on MUSE_GADGET_RTC
        default "pool.ntp.org"

    config MUSE_GADGET_ALARM
        bool "Daily alarm"
        depends on MUSE_GADGET_EXTRAS
        default y
        help
            At the time below (local), wakes the screen and chirps. Its
            time and an on/off switch are under Settings > General > Mode
            on the device, saved as the "alarm_min" (minutes after
            midnight) and "alarm_on" keys in the "gadget" NVS namespace,
            which override these once set.

    config MUSE_GADGET_ALARM_HOUR
        int "Alarm hour (0-23)"
        depends on MUSE_GADGET_ALARM
        range 0 23
        default 5

    config MUSE_GADGET_ALARM_MINUTE
        int "Alarm minute (0-59)"
        depends on MUSE_GADGET_ALARM
        range 0 59
        default 0

    config MUSE_GADGET_IMU
        bool "QMI8658 motion: wake on lift or double tap, shake for an earthquake, steps"
        depends on MUSE_GADGET_EXTRAS
        default y

    config MUSE_GADGET_MOTION_WAKE
        bool "Wake the screen when the board is picked up or tilted"
        depends on MUSE_GADGET_IMU
        default y
        help
            A double tap always wakes it.

    config MUSE_GADGET_AUTO_FLIP
        bool "Turn the screen upside down to match the board"
        depends on MUSE_GADGET_IMU
        default y
        help
            Charging stood on its keys, or carried upside down, the
            picture and touch turn 180 degrees so they read right way up
            (muse_orient.c), in every mode.

    config MUSE_GADGET_HOME_EXTRAS
        bool "Clock and battery on the face"
        depends on MUSE_GADGET_EXTRAS
        default y

    config MUSE_GADGET_NIGHT_FACE
        bool "Night face: a big clock, and Muse asleep in bed"
        depends on MUSE_GADGET_HOME_EXTRAS
        default y
        help
            In Night mode the clock grows to fill the top of the face and
            Muse, smaller and lower, sleeps tucked up in bed. It sits up to
            listen and answer, and goes back to sleep after. Needs
            LV_FONT_MONTSERRAT_48 for the clock.

    config MUSE_GADGET_UP_NEXT
        bool "Up next: a line on the face of what to get ready for"
        depends on MUSE_GADGET_HOME_EXTRAS && MUSE_HATCH
        default y
        help
            One dim line above the battery saying what's next today, from
            your calendar and plans as the Muse knows them. The gadget asks
            in the background, in a hidden chat of its own (never the one
            picked, and nothing on screen or spoken), at most once an hour
            while idle and in reach and once each morning, and hides an
            answer over three hours old (muse_up_next.c). ">brief" on the
            serial console asks now, ">brief?" prints what it has.

    config MUSE_GADGET_CHATS
        bool "Chats screen: swipe right from Muse to pick a chat"
        default y
        help
            A third screen, left of Muse, lists the main chat, the gadget's
            own chat and chats made on the device; the one tapped is where
            the conversation goes until the next restart, which starts on
            the main chat again (muse_chats_ui.c).

endmenu
```
